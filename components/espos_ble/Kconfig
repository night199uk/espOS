## components/espos_ble/Kconfig
```kconfig
menu "espOS BLE gateway"

    config ESPOS_BLE_POST_BATCH_MAX
        int "Advertisements per POST"
        default 40
        range 1 200
        help
            How many buffered advertisements one POST to
            /signalk/v2/api/ble/gateway/advertisements carries. Bounded so a
            flush in a busy marina cannot build an unbounded JSON document;
            what does not fit waits for the next ble.post_int_ms. The batch
            scratch is a static array (about 128 bytes per slot) and the
            serialised JSON is built on the heap, so raising this costs RAM
            twice over.

    config ESPOS_BLE_WS_BUFFER
        int "Control WebSocket frame buffer (bytes)"
        default 4096
        range 1024 16384
        help
            esp_websocket_client's buffer for the control socket. A
            gatt_subscribe for a device with many characteristics and init
            writes has to arrive in one frame -- the 1 KiB buffer of the
            implementation this replaced could not reassemble it. It also
            bounds the status frames going the other way.

    config ESPOS_BLE_GATTC_MAX_CONN
        int "Simultaneous GATT connections"
        default 3
        range 1 7
        help
            Connection slots in the GATT client and in the gateway's session
            table. The runtime setting ble.max_gatt_sess is clamped to this
            and its descriptor (config/ble.json) also says 3, so raise both.
            Bluedroid must be built for at least this many ACL links
            (BT_ACL_CONNECTIONS); on the ESP32-P4 the C6 co-processor's
            controller sets the real ceiling.

    config ESPOS_BLE_STACK_SIZE
        int "Gateway task stack size (bytes)"
        default 8192
        range 4096 32768
        help
            The task that serialises batches with cJSON and POSTs them
            through esp_http_client. The big scratch buffers are static, so
            this covers call depth, not payloads; a stack-protection fault
            here is a reboot loop rather than a degraded mode, hence the
            headroom.

    config ESPOS_BLE_STACK_IN_PSRAM
        bool "Put the gateway task's stack in PSRAM"
        depends on SPIRAM && FREERTOS_TASK_CREATE_ALLOW_EXT_MEM
        default y
        help
            The gateway task never touches flash, so its stack may live in
            PSRAM, which frees ESPOS_BLE_STACK_SIZE bytes of internal RAM. That
            matters on a single-chip board such as the ESP32-C5, where BLE,
            WiFi and the SignalK client share ~170 KB of internal RAM.

endmenu
```

## components/espos_httpd/Kconfig
```kconfig
menu "espOS HTTP server"

    config ESPOS_HTTPD_MAX_BODY
        int "Maximum request body size (bytes)"
        default 16384
        range 1024 262144
        help
            Requests with a larger Content-Length are rejected with 413.

    config ESPOS_HTTPD_STACK_SIZE
        int "Server task stack size (bytes)"
        default 8192
        range 4096 32768

    config ESPOS_HTTPD_TASK_PRIORITY
        int "Server task priority"
        default 5
        range 1 24

    config ESPOS_HTTPD_MAX_URI_HANDLERS
        int "Maximum number of URI handlers"
        default 64
        range 8 128

    config ESPOS_HTTPD_SSE_MAX_CLIENTS
        int "Maximum concurrent event-stream clients"
        default 3
        range 1 8
        help
            GET /api/v1/events keeps a socket open per client. The server's
            socket budget is 4 + this value, clamped to
            CONFIG_LWIP_MAX_SOCKETS - 3 (raise LWIP_MAX_SOCKETS for more).

    config ESPOS_HTTPD_SSE_MAX_CONNECT_CBS
        int "Maximum event-stream connect callbacks"
        default 8
        range 6 16
        help
            Each component that publishes to GET /api/v1/events registers one
            callback here, so a newly connected client gets the current state
            immediately instead of waiting for the next change. espOS itself
            ships five (net, wifi, sk, ota, ble); a firmware that adds its own
            needs room for those too. The floor is 6 rather than 5 because a
            build that cannot fit espOS's own publishers plus one is the bug
            this option exists to prevent.

            Running out is silent from the browser's side: the stream opens
            and every other component's snapshot arrives, so the one component
            that missed a slot looks merely idle rather than unregistered.

    config ESPOS_HTTPD_SSE_PING_S
        int "Event-stream keepalive interval (s)"
        default 15
        range 5 120

    config ESPOS_HTTPD_UI_EMBED
        bool "Build the web UI into the firmware image"
        default y
        help
            Embed the gzipped UI bundle (ui-dist/, about 25 KiB) in the app
            image and serve it from there. An OTA update writes only the app
            slot, never the "storage" partition, so a UI served from storage
            stays at whatever version was flashed over USB while the firmware
            moves on; one built into the app moves with it. A custom UI
            (espos_project_ui_partition(DIR ...)) is still served from storage.

    config ESPOS_HTTPD_WWW_DIR
        string "Mount point of the UI storage partition"
        default "/www"
        help
            The LittleFS "storage" partition is mounted here. It is served at
            / when the UI is not built in (ESPOS_HTTPD_UI_EMBED off) or the
            project packs a custom UI into it, and for files the built-in
            bundle does not have.

    config ESPOS_HTTPD_DEBUG_CRASH
        bool "Expose POST /api/v1/system/crash (deliberate panic, for testing core dumps)"
        default n

    config ESPOS_HTTPD_AUTH_REQUIRED
        bool "Refuse protected endpoints until an API key is configured"
        default n
        help
            With an empty httpd.api_key the REST API is open to the network
            (the default, so a device that predates authentication keeps
            working after an update). A product build that must never ship
            open turns this on: protected endpoints then answer
            403 auth_unconfigured until a key is set. The setup portal's
            network is exempt for exactly as long as that is true, which is
            where the first key is set; it is not exempt afterwards. See
            docs/security.md.

    config ESPOS_HTTPD_PORTAL_RECOVERY
        bool "Open a portal recovery window after a run of power cycles"
        default y
        help
            The setup access point is exempt from authentication only while
            no key is configured; once httpd.api_key is set, requests on it are
            judged like any other (the access point is open by default and
            comes up unattended, so being on it proves nothing). This is the
            way back in when the key is then lost and there is no cable:
            switching the device off and on again
            ESPOS_HTTPD_RECOVERY_CYCLES times, each within
            ESPOS_HTTPD_RECOVERY_CLEAR_S of the one before, exempts the portal
            for ESPOS_HTTPD_RECOVERY_WINDOW_S -- long enough to set a new key.
            Counted in NVS, and only while a key is set, so an open device
            writes nothing. Turn this off for a device whose power an
            untrusted person can reach, and keep a cable for it.
            See docs/security.md.

    config ESPOS_HTTPD_RECOVERY_CYCLES
        int "Power cycles that open the window"
        depends on ESPOS_HTTPD_PORTAL_RECOVERY
        default 3
        range 2 10
        help
            Two is enough to be reached by accident; three is the familiar
            number from consumer hardware and is hard to produce by mistake.

    config ESPOS_HTTPD_RECOVERY_CLEAR_S
        int "Seconds of uptime that reset the count"
        depends on ESPOS_HTTPD_PORTAL_RECOVERY
        default 20
        range 5 300
        help
            A boot that lasts this long clears the count, so only cycles in
            quick succession add up. It has to be longer than the device takes
            to reach espos_httpd_start(), or a cycle is never counted at all;
            20 s leaves room on every target espOS builds for.

    config ESPOS_HTTPD_RECOVERY_WINDOW_S
        int "How long the window stays open"
        depends on ESPOS_HTTPD_PORTAL_RECOVERY
        default 600
        range 60 3600
        help
            Finding the access point, joining it and typing a key takes a few
            minutes on a phone. The window closes by itself; a reboot ends it
            too, since it is kept in RAM.

    config ESPOS_HTTPD_MAX_SESSIONS
        int "Maximum concurrent login sessions"
        default 4
        range 1 16
        help
            Cookie sessions minted by POST /api/v1/auth/login, kept in RAM
            (about 48 bytes each). One more login than this evicts the
            session idle longest; a reboot forgets them all. Bearer requests
            use no session.

    config ESPOS_HTTPD_TLS
        bool "Serve the device's own web UI and API over HTTPS (reserved)"
        default n
        help
            Reserved; not implemented. The device's web server is plain http
            because a TLS server on the smaller targets costs RAM the
            application needs, and a self-signed certificate on a boat LAN
            buys little (docs/security.md). Turning this on changes nothing
            yet; the option exists so a future implementation has a stable
            name.

endmenu
```
