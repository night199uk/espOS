## components/espos_sk/Kconfig
```kconfig
menu "espOS SignalK"

    config ESPOS_SK_RX_FRAME_MAX
        int "Largest inbound stream frame kept (bytes)"
        default 16384
        range 2048 131072
        help
            Delta messages larger than this are dropped (logged). A
            subscription burst after reconnect (values + meta for many
            paths) can reach several KiB; raise on PSRAM boards that
            subscribe to whole families.

    config ESPOS_SK_TASK_STACK
        int "SignalK client task stack size (bytes)"
        default 12288
        range 6144 16384
        help
            The task that runs discovery, the token state machine and its HTTP
            legs (access request, poll, verify) plus the https probe. Meta
            reconciliation is NOT here -- reconcile_meta() is called from
            ws_task(), so it belongs to the stream task below.

            Measured rather than guessed: on an ESP32-C5 running the BLE
            gateway against a live server -- discovery, an approved token,
            meta for the published paths -- the high-water mark showed this
            task using 1488 B of the 12288 B it used to be given, i.e. 12 %.

            The default stays 12288 anyway, and that is deliberate: the
            server in that run was plain HTTP on port 80, so no TLS handshake
            ever completed on this task, and mbedTLS is by far the deepest call
            path it has (espos_sk_http_probe_https and the token legs all go
            through it). A 12 % high-water number measured with the deepest
            path never taken does not justify cutting the stack -- it only says
            the measurement was incomplete.

            Reducing it needs a high-water reading against a TLS server, not
            that one -- or, in a CONFIG_ESPOS_SK_TLS=n build where sk_tls.c is
            compiled out and no wss reading is possible, against the busiest
            http/ws workload that build supports.

            Lower it only against your own high-water numbers
            (CONFIG_FREERTOS_USE_TRACE_FACILITY +
            uxTaskGetStackHighWaterMark) taken on a TLS server, never to a
            round number that looks sufficient. A stack-protection fault here
            is a reboot loop rather than a degraded mode.

            The floor is 6144 for the same reason the default is not 2048: the
            TLS path on this task is unmeasured, so a range that invites a
            build down to 3 KB would be offering a setting nobody has shown to
            work.

    config ESPOS_SK_WS_TASK_STACK
        int "SignalK stream task stack size (bytes)"
        default 10240
        range 8192 16384
        help
            The websocket task: frame reassembly, delta parsing, inbound PUT
            dispatch and the notification sink.

            Raised from 8192 on a second measurement: a 112-minute run of the
            BLE gateway on an ESP32-C5 (control WebSocket on, REST traffic,
            OTA attempts) peaked at 6904 B -- up from the 5272 B of the first
            run, with only 1288 B of 8192 left, and still over plain ws with
            no TLS on this task. It parses whatever the server sends, so its
            depth depends on frames this device did not choose; the first run
            was simply a quieter server.

            It also carries the deeper HTTP work than its name suggests:
            reconcile_meta() runs here, and it issues espos_sk_http_get_meta()
            and espos_sk_http_put_meta() per path -- over TLS on a wss server.
            That path was not exercised in either measurement (plain HTTP), so
            the 6904 B peak is a floor of what it needs, not a budget to spend.

            The floor is 8192 rather than the 4096 a stack option would
            normally allow, because it is the smallest round size above the
            6904 B this task was measured using -- an option whose range lets a
            build fault on the first big frame is a trap, not a choice.

    config ESPOS_SK_TLS
        bool "Talk to the server over TLS (https/wss)"
        default y
        select MBEDTLS_CERTIFICATE_BUNDLE
        help
            Compile the https/wss transports. Which scheme is actually used is
            the sk.scheme setting (auto/http/https, default auto), so a build
            with this on still talks plain http to a plain server.

            On by default since the trust store landed. Before it the only
            thing espOS could do with a certificate was check it against the
            bundled Mozilla roots, which refuses every boat server -- they are
            self-signed, or signed by a CA the owner made. That made the option
            close to useless and off was the honest default. Now the first
            connection pins what the server presents (sk.tls_trust, default
            "tofu") and holds it to that afterwards, the way ssh does, so
            turning it on is a decision about the network rather than about
            whether the server has a certificate a browser would like.

            Flash cost, measured on esp32c6, y minus n on the same tree:

              with espos_ota   about 10 KB (the reference app: 1485308 vs
                               1475280 bytes). mbedTLS and the certificate
                               bundle are already linked for the https image
                               source, so what is added here is the trust
                               store, the transports and the verify path.
              without espos_ota  about 78 KB (the tls_server example: 1437772
                               vs 1358004). Most of that is the Mozilla root
                               bundle, which the trust store still needs as a
                               fallback in bundle mode.

            RAM: roughly 20 KB while a connection is open, and
            ESPOS_SK_TLS_MIN_FREE_BLOCK_KB below refuses a handshake when that
            much contiguous internal RAM is not free.

            Turning it off drops the transports and mbedTLS with them; sk.scheme
            then reads as http whatever it is set to, and the device says so
            once at startup.

    config ESPOS_SK_TLS_CA_MAX
        int "Largest CA certificate accepted (bytes)"
        depends on ESPOS_SK_TLS
        default 2048
        range 512 8192
        help
            Cap on the PEM in sk.ca_pem and on PUT /api/v1/sk/tls/ca, and the
            size of the buffer holding it. A single RSA-4096 CA certificate in
            PEM is about 2 KB; raise this only for a chain, and remember it is
            RAM that stays allocated for the life of the device.

    config ESPOS_SK_TLS_MIN_FREE_BLOCK_KB
        int "Internal RAM needed before a TLS handshake (KB)"
        depends on ESPOS_SK_TLS
        default 24
        range 8 64
        help
            A handshake is refused, and retried after the usual backoff, unless
            this much *contiguous* RAM is free in the pool mbedTLS allocates
            from: heap_caps_get_largest_free_block(MALLOC_CAP_INTERNAL |
            MALLOC_CAP_8BIT), or (MALLOC_CAP_SPIRAM | MALLOC_CAP_8BIT) when
            CONFIG_MBEDTLS_EXTERNAL_MEM_ALLOC puts mbedTLS in PSRAM. Total
            free heap is the wrong number on a PSRAM board, where tens of
            megabytes can hide the few kilobytes of internal RAM that
            actually matter.

            What it prevents is not a clean out-of-memory error. mbedTLS
            failing to allocate mid-handshake leaves a half-built session and a
            socket behind, and repeated on a reconnect loop it starves the WiFi
            stack of the same pool. Deferring is cheap, and the device raises a
            tlsMemory health condition so the reason is visible.

    config ESPOS_SK_TLS_HANDSHAKE_TIMEOUT_MS
        int "Wait for the one handshake slot (ms)"
        depends on ESPOS_SK_TLS
        default 10000
        range 1000 60000
        help
            Only one TLS handshake runs at a time on the device -- two at once
            is where the internal-RAM pool runs out, and the esp-tls attach
            hook carries no user pointer, so one at a time is also what makes
            the certificate-capture slot well defined. A caller that waits
            longer than this for the slot gives up and retries with its own
            backoff.

    config ESPOS_SK_HTTP_MAX_CONCURRENT
        int "Concurrent HTTP requests to the server"
        default 2
        range 1 8
        help
            Upper bound on espos_sk_http_* requests in flight at once --
            the token machine's and the meta reconciliation's own calls
            included. Each open request is a socket and, over TLS, roughly
            20 KB of RAM; a display that fetches one value per widget on a
            layout change would otherwise open dozens at the same moment.
            A caller over the limit waits up to its own timeout for a slot
            and gets ESP_ERR_TIMEOUT if none frees up.

    config ESPOS_SK_MAX_META
        int "Metadata declarations"
        default 32
        range 4 128
        help
            How many paths espos_sk_declare_meta() can describe. Each entry
            holds a path and its meta JSON and is reconciled with the server
            on every reconnect.

            One per custom path the device publishes; spec paths need none,
            because the server already knows their units. A device with a
            dozen sensors and a units line for each runs out at the old 16
            sooner than it looks, and the declaration that does not fit is
            the one silently missing its units in every dashboard.

    config ESPOS_SK_PENDING_MAX
        int "Values coalesced per batch window"
        default 32
        range 4 32
        help
            How many values one batch window may hold before it closes early
            and sends. Each slot costs about 370 bytes in the delta engine's
            allocation (a path, a value, a timestamp and its context), so 32
            is roughly 12 KB of internal RAM and 8 is about 3 KB.

            Lower it on a board where a TLS handshake or an OTA has to compete
            for contiguous internal RAM. Reaching this cap does not itself
            discard a pending value: a full window closes into a delta and a
            new one starts, so a smaller cap only means more, smaller messages.
            The resulting delta is still subject to the ring's configured
            overflow behaviour. ESPOS_SK_PENDING_MAX in espos_sk_delta.h stays
            the cap callers are told about.

    config ESPOS_SK_NOTIFICATIONS
        bool "Device-health notifications"
        default y
        help
            Publish espos_health conditions as SignalK notifications
            under notifications.espos.<label>.<key> -- memory pressure, a
            dependency that has gone away, whatever the application
            reports.

            Without them such a condition surfaces as a device that has
            quietly stopped working, which looks the same as a hardware
            fault and is the expensive kind of problem to diagnose.

            Turning it off drops the sink and the periodic low-memory
            check; conditions are still recorded by espos_health and still
            reach any other sink. The number of distinct conditions is
            ESPOS_HEALTH_MAX_CONDITIONS, under "espOS health".

endmenu
```

## components/espos_wifi/Kconfig
```kconfig
menu "espOS WiFi"

    config ESPOS_WIFI_MAX_NETWORKS
        int "Configured networks (priority slots)"
        default 4
        range 1 4
        help
            Number of ssidN/pskN/bssidN slots honoured from the "wifi"
            namespace (the descriptor declares four).

            The mDNS responder that used to be configured here moved to
            espos_net with the seam: CONFIG_ESPOS_NET_MDNS and
            CONFIG_ESPOS_NET_MDNS_MAX_SERVICES under "espOS network".

    config ESPOS_WIFI_DRAIN_TASK_STACK
        int "Driver action task stack size (bytes)"
        default 4096
        range 3072 16384
        help
            The task that runs the state machine's driver calls (connect,
            disconnect, the portal), reports the link to espos_net with its
            subscriber callbacks, and publishes the status to the web UI.
            These ran on the event, timer or HTTP task that dispatched them
            until they moved here, so the event loop no longer waits on a
            radio that is slow to answer.

    config ESPOS_WIFI_DRAIN_TASK_PRIO
        int "Driver action task priority"
        default 19
        range 1 24
        help
            FreeRTOS priority of the driver action task. Just below the
            default event loop (20), which ran this work before: a connect
            or the report that brings the network up does not wait behind
            application tasks, and the event loop still delivers the radio's
            answers first.

endmenu
```

## test/host/espos_usb_storage_test/sdkconfig.defaults
```kconfig
CONFIG_IDF_TARGET="linux"
CONFIG_UNITY_ENABLE_IDF_TEST_RUNNER=y
CONFIG_LOG_DEFAULT_LEVEL_WARN=y
CONFIG_PARTITION_TABLE_CUSTOM=y
CONFIG_PARTITION_TABLE_CUSTOM_FILENAME="partitions.csv"
CONFIG_PARTITION_TABLE_FILENAME="partitions.csv"
CONFIG_PARTITION_TABLE_OFFSET=0x8000
```
